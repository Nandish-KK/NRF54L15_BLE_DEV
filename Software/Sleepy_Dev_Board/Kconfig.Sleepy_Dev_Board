## Software/Sleepy_Dev_Board/Kconfig.Sleepy_Dev_Board
```kconfig
config BOARD_SLEEPY_DEV_BOARD
	select SOC_NRF54L15_CPUAPP if BOARD_SLEEPY_DEV_BOARD_NRF54L15_CPUAPP
	select SOC_NRF54L15_CPUFLPR if \
		BOARD_SLEEPY_DEV_BOARD_NRF54L15_CPUFLPR || \
		BOARD_SLEEPY_DEV_BOARD_NRF54L15_CPUFLPR_XIP
		
```

## Software/board_files/board.yml
```yaml
board:
  name: Sleepy_Dev_Board
  vendor: Thesynthscope
  socs:
  - name: nrf54l15
    variants:
    - name: xip
      cpucluster: cpuflpr
```
